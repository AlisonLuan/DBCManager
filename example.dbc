VERSION "Example DBC file"

NS_ :

BS_:

BU_: NodeA NodeB

BO_ 100 ExampleMessage1: 8 NodeA
 SG_ Speed : 0|8@1+ (0.1,0) [0|250] "km/h"  NodeB
 SG_ RPM : 8|16@1+ (1,0) [0|8000] "rpm"  NodeB

BO_ 200 ExampleMessage2: 4 NodeB
 SG_ Temperature : 0|8@1+ (1,0) [-40|215] "°C"  NodeA
 SG_ Voltage : 8|16@1+ (0.01,0) [0|65.535] "V"  NodeA

CM_ BO_ 100 "This is an example message with Speed and RPM signals.";
CM_ SG_ 100 Speed "The speed of the vehicle in km/h.";
CM_ SG_ 100 RPM "The engine revolutions per minute.";
CM_ BO_ 200 "This is another example message with Temperature and Voltage signals.";
CM_ SG_ 200 Temperature "Ambient temperature in Celsius.";
CM_ SG_ 200 Voltage "Battery voltage in Volts.";
